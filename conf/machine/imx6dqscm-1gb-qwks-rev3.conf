## conf/machine/imx6dqscm-1gb-qwks-rev3.conf
```bitbake
#@TYPE: Machine
#@NAME: Freescale i.MX6QSCM EVB
#@SOC: i.MX6Q
#@DESCRIPTION: Machine configuration for Freescale i.MX6SCM EVB
#@MAINTAINER: Alejandro Sierra <alejandro.guiza@nxp.com>

require conf/machine/include/imx6sabresd-common.inc

SOC_FAMILY = "mx6:mx6q"

KERNEL_DEVICETREE = "imx6dqscm-1gb-qwks-rev3-fix-ldo.dtb imx6dqscm-1gb-qwks-rev3-hdcp-fix-ldo.dtb imx6dqscm-1gb-qwks-rev3-btwifi-fix-ldo.dtb"

UBOOT_CONFIG ??= "sd"
UBOOT_CONFIG[sd] = "mx6dqscm_1gb_fix_qwks_rev3_defconfig,sdcard"
UBOOT_CONFIG[mfgtool] = "mx6dqscm_1gb_fix_qwks_rev3_defconfig"
UBOOT_CONFIG[spinor] = "mx6dqscm_1gb_fix_qwks_rev3_spinor_defconfig"
```
